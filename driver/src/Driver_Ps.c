#include "Driver_Ps.h"
#include "Driver_Magic.h"

static enum Status_Type { WAITING, STARTED, VALIDED, INTERRUPTED };
static enum Status_Type status = WAITING;

static uint8_t len;
static uint8_t id;
static uint8_t counter = 0;

static uint8_t psDebugEnabled = 0;

void Ps_On_Received(PsData_Type *PsData, uint8_t newByte) {
    Ps_Append(&PsData, newByte);
    if (psDebugEnabled) printf("[%d:%d]", counter, newByte);
    if (status == WAITING && newByte == SOP) {
        Ps_On_Start(&PsData);
    } else if (status == STARTED && counter == 2) {
        Ps_Parse_Header(&PsData, newByte);
    } else if (counter == 2 * len + 4 && newByte == EOP) {
        Ps_Valid(&PsData);
    }
}

void Ps_Append(PsData_Type *PsData, uint8_t value) {
    PsData->data[counter] = value;
    counter++;
}

void Ps_Parse_Header(PsData_Type *PsData, uint8_t value) {
    len = value >> 4;
    id  = value & 0x0f;
    if (psDebugEnabled) printf("len:%d\r\n", len);
}

void Ps_Valid(PsData_Type *PsData) {
    uint8_t crc = PsData->data[2 * len + 2];
    if (CRC_Valid(PsData->data + 1, 2 * len + 1, crc)) {
        if (psDebugEnabled) printf("done%d\r\n", len);
        Ps_On_Done(&PsData);
    } else {
        Ps_On_Interrupted(&PsData);
    }
}

void Ps_Reset(PsData_Type *PsData) {
    int i;
    for (i = 0; i < 34; i++) {
        PsData->data[i] = 0;
    }
    counter = 0;
    status  = WAITING;
    if (psDebugEnabled) printf("reset\r\n");
}

void Ps_On_Start(PsData_Type *PsData) {
    if (psDebugEnabled) printf("start\r\n");
    status = STARTED;
}

void Ps_On_Done(PsData_Type *PsData) {
    // todo:解析data
    status = VALIDED;
    Ps_DataAnalysis(&PsData);
    Ps_Reset(&PsData);
}

void Ps_On_Interrupted(PsData_Type *PsData) {
    if (psDebugEnabled) printf("interrupted\r\n");
    status = INTERRUPTED;
    Ps_Reset(&PsData);
}

static const unsigned char crc_table[] = {
    0x00, 0x31, 0x62, 0x53, 0xc4, 0xf5, 0xa6, 0x97, 0xb9, 0x88, 0xdb, 0xea, 0x7d, 0x4c, 0x1f, 0x2e, 0x43, 0x72, 0x21, 0x10, 0x87, 0xb6, 0xe5, 0xd4, 0xfa, 0xcb,
    0x98, 0xa9, 0x3e, 0x0f, 0x5c, 0x6d, 0x86, 0xb7, 0xe4, 0xd5, 0x42, 0x73, 0x20, 0x11, 0x3f, 0x0e, 0x5d, 0x6c, 0xfb, 0xca, 0x99, 0xa8, 0xc5, 0xf4, 0xa7, 0x96,
    0x01, 0x30, 0x63, 0x52, 0x7c, 0x4d, 0x1e, 0x2f, 0xb8, 0x89, 0xda, 0xeb, 0x3d, 0x0c, 0x5f, 0x6e, 0xf9, 0xc8, 0x9b, 0xaa, 0x84, 0xb5, 0xe6, 0xd7, 0x40, 0x71,
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    0x1a, 0x2b, 0xbc, 0x8d, 0xde, 0xef, 0x82, 0xb3, 0xe0, 0xd1, 0x46, 0x77, 0x24, 0x15, 0x3b, 0x0a, 0x59, 0x68, 0xff, 0xce, 0x9d, 0xac};

uint8_t CRC_Calculate(uint8_t *data, uint8_t len) {
    uint8_t crc = 0x00;
    uint8_t i;

    for (i = 0; i < len; i++) {
        if (psDebugEnabled) printf("crc_add: %x\r\n", *(data + i));
        crc = crc_table[crc ^ *(data + i)];
    }
    // DECO
    // crcCopy = crc;
    if (psDebugEnabled) printf("crc: %x\r\n", crc);
    return crc;
}

uint8_t CRC_Valid(uint8_t *data, uint8_t len, uint8_t crc) {
    return 1;
    // return CRC_Calculate(data, len) == crc;
}

void Ps_DataAnalysis(PsData_Type *PsData) {
    int i = 0;
    if (psDebugEnabled) printf("rec: %d %d\r\n", PsData->data[2], PsData->data[3]);

    for (i = 0; i < len; i++) {
        PsData->data[i] = (PsData->data[2 * i + 2] << 8) | (PsData->data[2 * i + 3]);
    }
    Ps_DataUnused(&PsData);
}

void Ps_DataUnused(PsData_Type *PsData) {
    PsData->data[16] = 0; // 数据未被使用过
}

void Ps_DataUsed(PsData_Type *PsData) {
    PsData->data[16] = 1; // 数据被使用过
}
